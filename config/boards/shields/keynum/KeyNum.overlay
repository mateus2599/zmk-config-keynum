/ {
    chosen {
        zmk,kscan = &default_kscan; 
    };

    default_kscan: kscan {
        compatible = "zmk,kscan-gpio-direct";  
        label = "default_kscan"

        input-gpios = <&gpio1 15 GPIO_ACTIVE_HIGH GPIO_PULL_DOWN >,  // num, /, *, -
                    <&gpio1 13 GPIO_ACTIVE_HIGH GPIO_PULL_DOWN >,    // 7, 8, 9, 0
                    <&gpio1 11 GPIO_ACTIVE_HIGH GPIO_PULL_DOWN >,    // 4, 5, 6
                    <&gpio0 10 GPIO_ACTIVE_HIGH GPIO_PULL_DOWN >,    // 1, 2, 3, Enter
                    <&gpio0 9 GPIO_ACTIVE_HIGH GPIO_PULL_DOWN >,     // +, ., Del 
                    <&gpio1 0 GPIO_ACTIVE_HIGH GPIO_PULL_DOWN >,     // Coluna 1
                    <&gpio0 11 GPIO_ACTIVE_HIGH GPIO_PULL_DOWN >,    // Coluna 2
                    <&gpio1 4 GPIO_ACTIVE_HIGH GPIO_PULL_DOWN >,     // Coluna 3
                    <&gpio1 6 GPIO_ACTIVE_HIGH GPIO_PULL_DOWN >;     // Coluna 4 
    }; 
};
